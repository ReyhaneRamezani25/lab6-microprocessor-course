	EXPORT __main
RCC_BASE_ADDR EQU 0x40023800
RCC_AHB1ENR_REG EQU (RCC_BASE_ADDR+0x30)

GPIOC_BASE_ADDR EQU 0x40020800
GPIOC_MODER_REG EQU (GPIOC_BASE_ADDR+0x00)
GPIOC_IDR_REG EQU (GPIOC_BASE_ADDR+0x10)
	
GPIOA_BASE_ADDR EQU 0x40020000
GPIOA_MODER_REG EQU (GPIOA_BASE_ADDR+0x00)
GPIOA_ODR_REG  EQU (GPIOA_BASE_ADDR+0x14)
	
	 AREA MYCODE,CODE,READONLY
		ENTRY
		

	
__main PROC
	;ENABLING CLK OF GPIOA AND GPIOC
	 LDR R0,=RCC_AHB1ENR_REG
	 LDR R1,[R0]
	 ORR R1,#((1<<0) :OR: (1<<2))
	 STR R1,[R0]
	 ;MAKING PA5 OUTPUT
	 LDR R0,=GPIOA_MODER_REG
	 LDR R1,[R0]
	 ORR R1,#(0x1 :SHL: 10)
	 STR R1,[R0]
	 ;MAKING PC13 INPUT(BUTTON)
	 LDR R0,=GPIOC_MODER_REG
	 LDR R1, [R0]
	 AND R1,#(:NOT:(0x3 :SHL: 26))
	 STR R1, [R0]
	 
LOOP_BLINK
     ;CHECK BUTTON
     LDR R0,=GPIOC_IDR_REG
	 LDR R1, [R0]
	 AND R1, #(1<<13)
	 CMP R1, #0
	 BNE LOOP_BLINK
	 ;BLINK LED
	 LDR R0,=GPIOA_ODR_REG
	 LDR R1, [R0]
	 ORR R1, #(1 :SHL: 5)
	 STR R1, [R0]
	 BL DELAY
	 LDR R0,=GPIOA_ODR_REG
	 LDR R1, [R0]
	 AND R1, #(:NOT:(1 :SHL: 5))
	 STR R1, [R0]
	 BL DELAY
	 B  LOOP_BLINK
DELAY
     LDR R0,=1000000
LOOP_DELAY
     SUB R0,#1
	 CMP R0,#0
	 BNE LOOP_DELAY
	 BX   LR
	 
LOOP_END
     B  LOOP_END
	 
	 ENDP
			
	END	 